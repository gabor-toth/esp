## common/Kconfig.projbuild
```kconfig
menu "Own common Configuration"

    config OWN_CONFIG_HOST_NAME
        string "Host name"
        default "myhostname"
        help
            Host name advertised with mDNS.

    config OWN_CONFIG_HOST_NAME_SUFFIX_WITH_CHIPID
        bool "Append chip id to host name"
        default n
        help
            Appends the chip id to the host name to distinguish between instances of the same device.

endmenu
```

## hajo/main/Kconfig.projbuild
```kconfig
menu "Example Configuration"

    choice EXAMPLE_ADC2_CHANNEL
        bool "ADC2 Channel Num"
        depends on IDF_TARGET_ESP32
        default EXAMPLE_ADC2_CHANNEL_7
        help
            The channel of ADC2 used in this example.

        config EXAMPLE_ADC2_CHANNEL_0
            bool "ADC2 Channel 0 (GPIO 4)"
        config EXAMPLE_ADC2_CHANNEL_1
            bool "ADC2 Channel 1 (GPIO 0)"
        config EXAMPLE_ADC2_CHANNEL_2
            bool "ADC2 Channel 2 (GPIO 2)"
        config EXAMPLE_ADC2_CHANNEL_3
            bool "ADC2 Channel 3 (GPIO 15)"
        config EXAMPLE_ADC2_CHANNEL_4
            bool "ADC2 Channel 4 (GPIO 13)"
        config EXAMPLE_ADC2_CHANNEL_5
            bool "ADC2 Channel 5 (GPIO 12)"
        config EXAMPLE_ADC2_CHANNEL_6
            bool "ADC2 Channel 6 (GPIO 14)"
        config EXAMPLE_ADC2_CHANNEL_7
            bool "ADC2 Channel 7 (GPIO 27)"
        config EXAMPLE_ADC2_CHANNEL_8
            bool "ADC2 Channel 8 (GPIO 25)"
        config EXAMPLE_ADC2_CHANNEL_9
            bool "ADC2 Channel 9 (GPIO 26)"
    endchoice

    choice EXAMPLE_ADC2_CHANNEL
        bool "ADC2 Channel Num"
        depends on IDF_TARGET_ESP32S2
        default EXAMPLE_ADC2_CHANNEL_7
        help
            The channel of ADC2 used in this example.

        config EXAMPLE_ADC2_CHANNEL_0
            bool "ADC2 Channel 0 (GPIO 11)"
        config EXAMPLE_ADC2_CHANNEL_1
            bool "ADC2 Channel 1 (GPIO 12)"
        config EXAMPLE_ADC2_CHANNEL_2
            bool "ADC2 Channel 2 (GPIO 13)"
        config EXAMPLE_ADC2_CHANNEL_3
            bool "ADC2 Channel 3 (GPIO 14)"
        config EXAMPLE_ADC2_CHANNEL_4
            bool "ADC2 Channel 4 (GPIO 15)"
        config EXAMPLE_ADC2_CHANNEL_5
            bool "ADC2 Channel 5 (GPIO 16)"
        config EXAMPLE_ADC2_CHANNEL_6
            bool "ADC2 Channel 6 (GPIO 17)"
        config EXAMPLE_ADC2_CHANNEL_7
            bool "ADC2 Channel 7 (GPIO 18)"
        config EXAMPLE_ADC2_CHANNEL_8
            bool "ADC2 Channel 8 (GPIO 19)"
        config EXAMPLE_ADC2_CHANNEL_9
            bool "ADC2 Channel 9 (GPIO 20)"
    endchoice

    config EXAMPLE_ADC2_CHANNEL
        int
        default 0 if EXAMPLE_ADC2_CHANNEL_0
        default 1 if EXAMPLE_ADC2_CHANNEL_1
        default 2 if EXAMPLE_ADC2_CHANNEL_2
        default 3 if EXAMPLE_ADC2_CHANNEL_3
        default 4 if EXAMPLE_ADC2_CHANNEL_4
        default 5 if EXAMPLE_ADC2_CHANNEL_5
        default 6 if EXAMPLE_ADC2_CHANNEL_6
        default 7 if EXAMPLE_ADC2_CHANNEL_7
        default 8 if EXAMPLE_ADC2_CHANNEL_8
        default 9 if EXAMPLE_ADC2_CHANNEL_9

    choice EXAMPLE_DAC_CHANNEL
        bool "DAC Channel Num"
        depends on IDF_TARGET_ESP32
        default EXAMPLE_DAC_CHANNEL_1
        help
            The channel of DAC used in this example.

        config EXAMPLE_DAC_CHANNEL_1
            bool "DAC Channel 1 (GPIO25)"
        config EXAMPLE_DAC_CHANNEL_2
            bool "DAC Channel 2 (GPIO26)"
    endchoice

    choice EXAMPLE_DAC_CHANNEL
        bool "DAC Channel Num"
        depends on IDF_TARGET_ESP32S2
        default EXAMPLE_DAC_CHANNEL_1
        help
            The channel of DAC used in this example.

        config EXAMPLE_DAC_CHANNEL_1
            bool "DAC Channel 1 (GPIO17)"
        config EXAMPLE_DAC_CHANNEL_2
            bool "DAC Channel 2 (GPIO18)"
    endchoice

    config EXAMPLE_DAC_CHANNEL
        int
        default 0 if EXAMPLE_DAC_CHANNEL_1
        default 1 if EXAMPLE_DAC_CHANNEL_2

    config EXAMPLE_MDNS_HOST_NAME
        string "mDNS Host Name"
        default "esp-home"
        help
            Specify the domain name used in the mDNS service.
            Note that webpage also take it as a part of URL where it will send GET/POST requests to.

    config MDNS_INSTANCE_NAME
        string "mDNS instance Name"
        default "hajo web server"
        help
            mdns_instance_name_set( CONFIG_MDNS_INSTANCE_NAME )

    choice EXAMPLE_WEB_DEPLOY_MODE
        prompt "Website deploy mode"
        default EXAMPLE_WEB_DEPLOY_SEMIHOST
        help
            Select website deploy mode.
            You can deploy website to host, and ESP32 will retrieve them in a semihost way (JTAG is needed).
            You can deploy website to SD card or SPI flash, and ESP32 will retrieve them via SDIO/SPI interface.
            Detailed operation steps are listed in the example README file.
        config EXAMPLE_WEB_DEPLOY_SEMIHOST
            bool "Deploy website to host (JTAG is needed)"
            help
                Deploy website to host.
                It is recommended to choose this mode during developing.
        config EXAMPLE_WEB_DEPLOY_SD
            depends on IDF_TARGET_ESP32
            bool "Deploy website to SD card"
            help
                Deploy website to SD card.
                Choose this production mode if the size of website is too large (bigger than 2MB).
        config EXAMPLE_WEB_DEPLOY_SF
            bool "Deploy website to SPI Nor Flash"
            help
                Deploy website to SPI Nor Flash.
                Choose this production mode if the size of website is small (less than 2MB).
    endchoice

    if EXAMPLE_WEB_DEPLOY_SEMIHOST
        config EXAMPLE_HOST_PATH_TO_MOUNT
            string "Host path to mount (e.g. absolute path to web dist directory)"
            default "PATH-TO-WEB-DIST_DIR"
            help
                When using semihost in ESP32, you should specify the host path which will be mounted to VFS.
                Note that only absolute path is acceptable.
    endif

    config EXAMPLE_WEB_MOUNT_POINT
        string "Website mount point in VFS"
        default "/www"
        help
            Specify the mount point in VFS.

endmenu
```
